## conf/layer.conf
```bitbake
# We have a conf and classes directory, append to BBPATH
# BBPATH .= ":${LAYERDIR}"

# We have a recipes directory, add to BBFILES
BBFILES += "${LAYERDIR}/recipes-*/*/*.bb ${LAYERDIR}/recipes-*/*/*.bbappend"

BBFILE_COLLECTIONS += "batman-adv-layer"
BBFILE_PATTERN_batman-adv-layer := "^${LAYERDIR}/"
BBFILE_PRIORITY_batman-adv-layer = "98"

# Let us add layer-specific bbappends which are only applied when that
# layer is included in our configuration
BBFILES += "${@' '.join('${LAYERDIR}/%s/recipes*/*/*.bbappend' % layer \
               for layer in BBFILE_COLLECTIONS.split())}"

#
#
LAYERDEPENDS_meta-batman-adv-layer = " \
    core \
    freescale-layer \
    fsl-arm-extra \
    toradex-bsp-common-layer \
    toradex-nxp-layer \
    voxel-layer \
    "
```
